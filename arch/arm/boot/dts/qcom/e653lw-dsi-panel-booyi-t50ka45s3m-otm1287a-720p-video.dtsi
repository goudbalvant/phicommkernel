/* Copyright (c) 2014, The Linux Foundation. All rights reserved.
 *
 * This program is free software; you can redistribute it and/or modify
 * it under the terms of the GNU General Public License version 2 and
 * only version 2 as published by the Free Software Foundation.
 *
 * This program is distributed in the hope that it will be useful,
 * but WITHOUT ANY WARRANTY; without even the implied warranty of
 * MERCHANTABILITY or FITNESS FOR A PARTICULAR PURPOSE.  See the
 * GNU General Public License for more details.
 */

&mdss_mdp {
	dsi_booyi_t50ka45s3m_otm1287a_720p_video: qcom,mdss_dsi_booyi_t50ka45s3m_otm1287a_720p_video {
		qcom,mdss-dsi-panel-name = "booyi t50ka45s3m otm1287a 720p video mode dsi panel";
		qcom,mdss-dsi-panel-controller = <&mdss_dsi0>;
		qcom,mdss-dsi-panel-type = "dsi_video_mode";
		qcom,mdss-dsi-panel-destination = "display_1";
		qcom,mdss-dsi-panel-framerate = <60>;
		qcom,mdss-dsi-virtual-channel-id = <0>;
		qcom,mdss-dsi-stream = <0>;
		qcom,mdss-dsi-panel-width = <720>;
		qcom,mdss-dsi-panel-height = <1280>;
		qcom,mdss-dsi-h-front-porch = <44>;
		qcom,mdss-dsi-h-back-porch = <42>;
		qcom,mdss-dsi-h-pulse-width = <2>;
		qcom,mdss-dsi-h-sync-skew = <0>;
		qcom,mdss-dsi-v-front-porch = <16>;
		qcom,mdss-dsi-v-back-porch = <14>;
		qcom,mdss-dsi-v-pulse-width = <2>;
		qcom,mdss-dsi-h-left-border = <0>;
		qcom,mdss-dsi-h-right-border = <0>;
		qcom,mdss-dsi-v-top-border = <0>;
		qcom,mdss-dsi-v-bottom-border = <0>;
		qcom,mdss-dsi-bpp = <24>;
		qcom,mdss-dsi-color-order = "rgb_swap_rgb";
		qcom,mdss-dsi-underflow-color = <0xff>;
		qcom,mdss-dsi-border-color = <0>;
		qcom,mdss-dsi-on-command = [
			29 01 00 00 00 00 02 00 00
			29 01 00 00 00 00 04 ff 12 87 01	//EXTC=1
			29 01 00 00 00 00 02 00 80	        //Orise mode enable
			29 01 00 00 00 00 03 ff 12 87
			29 01 00 00 00 00 02 00 92           
			29 01 00 00 00 00 03 ff 30 02 //20
		//-------------------- panel setting --------------------//
			29 01 00 00 00 00 02 00 80             //TCON Setting
			29 01 00 00 00 00 0A c0 00 64 00 10 10 00 64 10 10

			29 01 00 00 00 00 02 00 90             //Panel Timing Setting
			29 01 00 00 00 00 07 c0 00 5c 00 01 00 04

			29 01 00 00 00 00 02 00 a2
			29 01 00 00 00 00 04 C0 01 00 00

			29 01 00 00 00 00 02 00 b3             //Interval Scan Frame: 0 frame, column inversion
			29 01 00 00 00 00 03 c0 00 55

			29 01 00 00 00 00 02 00 81             //frame rate:60Hz
			29 01 00 00 00 00 02 c1 55

		//-------------------- power setting --------------------//
			29 01 00 00 00 00 02 00 a0             //dcdc setting
			29 01 00 00 00 00 0F c4 05 10 04 02 05 15 11 05 10 07 02 05 15 11

			29 01 00 00 00 00 02 00 b0             //clamp voltage setting
			29 01 00 00 00 00 03 c4 00 00

			29 01 00 00 00 00 02 00 91             //VGH=13V, VGL=-12V, pump ratio:VGH=6x, VGL=-5x
			29 01 00 00 00 00 03 c5 29 52

			29 01 00 00 00 00 02 00 00             //GVDD=4.204V, NGVDD=-4.204V
			29 01 00 00 00 00 03 d8 94 94          //94=4.396

			29 01 00 00 00 00 02 00 00 		//VCOM=-0.240V
			29 01 00 00 00 00 02 d9 44             //0d

			29 01 00 00 00 00 02 00 b3             //VDD_18V=1.7V, LVDSVDD=1.6V
			29 01 00 00 00 00 02 c5 84

			29 01 00 00 00 00 02 00 bb             //LVD voltage level setting
			29 01 00 00 00 00 02 c5 8a

			29 01 00 00 00 00 02 00 82		//chopper
			29 01 00 00 00 00 02 C4 0a

			29 01 00 00 00 00 02 00 c6		//debounce
			29 01 00 00 00 00 02 b0 03

		//-------------------- control setting --------------------//
			29 01 00 00 00 00 02 00 00             //ID1
			29 01 00 00 00 00 02 d0 40

			29 01 00 00 00 00 02 00 00             //ID2, ID3
			29 01 00 00 00 00 03 d1 00 00

		//-------------------- power on setting --------------------//
			29 01 00 00 00 00 02 00 80             //source blanking frame = black, defacult='30'
			29 01 00 00 00 00 02 c4 00

			29 01 00 00 00 00 02 00 98             //vcom discharge=gnd:'10', '00'=disable
			29 01 00 00 00 00 02 c5 10

			29 01 00 00 00 00 02 00 81
			29 01 00 00 00 00 02 f5 15  // ibias off
			29 01 00 00 00 00 02 00 83
			29 01 00 00 00 00 02 f5 15  // lvd off
			29 01 00 00 00 00 02 00 85
			29 01 00 00 00 00 02 f5 15  // gvdd off
			29 01 00 00 00 00 02 00 87
			29 01 00 00 00 00 02 f5 15  // lvdsvdd off
			29 01 00 00 00 00 02 00 89
			29 01 00 00 00 00 02 f5 15  // nvdd_18 off
			29 01 00 00 00 00 02 00 8b
			29 01 00 00 00 00 02 f5 15  // en_vcom off

			29 01 00 00 00 00 02 00 95
			29 01 00 00 00 00 02 f5 15  // pump3 off
			29 01 00 00 00 00 02 00 97
			29 01 00 00 00 00 02 f5 15  // pump4 off
			29 01 00 00 00 00 02 00 99
			29 01 00 00 00 00 02 f5 15  // pump5 off

			29 01 00 00 00 00 02 00 a1
			29 01 00 00 00 00 02 f5 15  // gamma off
			29 01 00 00 00 00 02 00 a3
			29 01 00 00 00 00 02 f5 15  // sd ibias off
			29 01 00 00 00 00 02 00 a5
			29 01 00 00 00 00 02 f5 15  // sdpch off
			29 01 00 00 00 00 02 00 a7
			29 01 00 00 00 00 02 f5 15  // sdpch bias off
			29 01 00 00 00 00 02 00 ab
			29 01 00 00 00 00 02 f5 18  // ddc osc off

			29 01 00 00 00 00 02 00 94             //VCL pump dis
			29 01 00 00 00 00 03 f5 00 00

			29 01 00 00 00 00 02 00 d2             //VCL reg. en
			29 01 00 00 00 00 03 f5 06 15

			29 01 00 00 00 00 02 00 b2             //VGLO1
			29 01 00 00 00 00 03 f5 00 00

			29 01 00 00 00 00 02 00 b6             //VGLO2
			29 01 00 00 00 00 03 f5 00 00

			29 01 00 00 00 00 02 00 b4             //VGLO1/2 Pull low setting
			29 01 00 00 00 00 02 c5 cc		//d[7] vglo1 d[6] vglo2 => 0: pull vss, 1: pull vgl

		//-------------------- for Power IC ---------------------------------
			29 01 00 00 00 00 02 00 90             //Mode-3
			29 01 00 00 00 00 05 f5 02 11 02 15

			29 01 00 00 00 00 02 00 90             //2xVPNL, 1.5*=00, 2*=50, 3*=a0
			29 01 00 00 00 00 02 c5 50

			29 01 00 00 00 00 02 00 94             //Frequency
			29 01 00 00 00 00 02 c5 77

		//-------------------- panel timing state control --------------------//
			29 01 00 00 00 00 02 00 80             //panel timing state control
			29 01 00 00 00 00 0C cb 00 00 00 00 00 00 00 00 00 00 00

			29 01 00 00 00 00 02 00 90             //panel timing state control
			29 01 00 00 00 00 10 cb 00 00 00 00 00 00 00 00 00 00 00 ff 00 ff 00

			29 01 00 00 00 00 02 00 a0             //panel timing state control
			29 01 00 00 00 00 10 cb ff 00 ff 00 00 00 00 00 00 00 00 00 00 00 00

			29 01 00 00 00 00 02 00 b0             //panel timing state control
			29 01 00 00 00 00 10 cb 00 00 00 ff 00 ff 00 ff 00 ff 00 00 00 00 00

			29 01 00 00 00 00 02 00 c0             //panel timing state control
			29 01 00 00 00 00 10 cb 00 00 00 00 00 00 00 05 05 00 05 05 05 05 05

			29 01 00 00 00 00 02 00 d0             //panel timing state control
			29 01 00 00 00 00 10 cb 05 05 05 05 05 00 00 00 00 00 00 00 00 00 05

			29 01 00 00 00 00 02 00 e0             //panel timing state control
			29 01 00 00 00 00 0F cb 05 00 05 05 05 05 05 05 05 05 05 05 00 00

			29 01 00 00 00 00 02 00 f0             //panel timing state control
			29 01 00 00 00 00 0C cb ff ff ff ff ff ff ff ff ff ff ff

		//-------------------- panel pad mapping control --------------------//
			29 01 00 00 00 00 02 00 80             //panel pad mapping control
			29 01 00 00 00 00 10 cc 00 00 00 00 00 00 00 05 07 00 11 15 13 17 0d

			29 01 00 00 00 00 02 00 90             //panel pad mapping control
			29 01 00 00 00 00 10 cc 09 0f 0b 01 03 00 00 00 00 00 00 00 00 00 06

			29 01 00 00 00 00 02 00 a0             //panel pad mapping control
			29 01 00 00 00 00 0F cc 08 00 12 16 14 18 0e 0a 10 0c 02 04 00 00

			29 01 00 00 00 00 02 00 b0             //panel pad mapping control
			29 01 00 00 00 00 10 cc 00 00 00 00 00 00 00 04 02 00 14 18 12 16 0c

			29 01 00 00 00 00 02 00 c0             //panel pad mapping control
			29 01 00 00 00 00 10 cc 10 0a 0e 08 06 00 00 00 00 00 00 00 00 00 03

			29 01 00 00 00 00 02 00 d0             //panel pad mapping control
			29 01 00 00 00 00 0F cc 01 00 13 17 11 15 0b 0f 09 0d 07 05 00 00

		//-------------------- panel timing setting --------------------//
			29 01 00 00 00 00 02 00 80             //panel VST setting
			29 01 00 00 00 00 0D ce 87 03 28 86 03 28 85 03 28 84 03 28

			29 01 00 00 00 00 02 00 90             //panel VEND setting
			29 01 00 00 00 00 0F ce 34 fc 28 34 fd 28 34 fe 28 34 ff 28 00 00
		 
			29 01 00 00 00 00 02 00 a0             //panel CLKA1/2 setting
			29 01 00 00 00 00 0F ce 38 07 05 00 00 28 00 38 06 05 01 00 28 00

			29 01 00 00 00 00 02 00 b0             //panel CLKA3/4 setting
			29 01 00 00 00 00 0F ce 38 05 05 02 00 28 00 38 04 05 03 00 28 00

			29 01 00 00 00 00 02 00 c0             //panel CLKb1/2 setting
			29 01 00 00 00 00 0F ce 38 03 05 04 00 28 00 38 02 05 05 00 28 00

			29 01 00 00 00 00 02 00 d0             //panel CLKb3/4 setting
			29 01 00 00 00 00 0F ce 38 01 05 06 00 28 00 38 00 05 07 00 28 00

			29 01 00 00 00 00 02 00 80             //panel CLKc1/2 setting
			29 01 00 00 00 00 0F cf 38 07 05 00 00 18 25 38 06 05 01 00 18 25

			29 01 00 00 00 00 02 00 90             //panel CLKc3/4 setting
			29 01 00 00 00 00 0F cf 38 05 05 02 00 18 25 38 04 05 03 00 18 25

			29 01 00 00 00 00 02 00 a0             //panel CLKd1/2 setting
			29 01 00 00 00 00 0F cf 38 03 05 04 00 18 25 38 02 05 05 00 18 25

			29 01 00 00 00 00 02 00 b0             //panel CLKd3/4 setting
			29 01 00 00 00 00 0F cf 38 01 05 06 00 18 25 38 00 05 07 00 18 25

			29 01 00 00 00 00 02 00 c0             //panel ECLK setting
			29 01 00 00 00 00 0C cf 01 01 20 20 00 00 01 81 00 03 08

			//-------------------- gamma --------------------//

			29 01 00 00 00 00 02 00 00
			29 01 00 00 00 00 15 E1 04 1b 2a 39 4b 58 5c 8a 7b 95 6e 59 6a 44 42 33 24 19 0a 06

			29 01 00 00 00 00 02 00 00
			29 01 00 00 00 00 15 E2 04 1b 2a 39 4b 58 5c 8a 7b 95 6e 59 6a 43 42 33 24 19 0a 06


		  	29 01 00 00 00 00 02 00 00             //Orise mode disable
		  	29 01 00 00 00 00 04 ff ff ff ff

			05 01 00 00 78 00 02 11 00
			05 01 00 00 00 00 02 29 00];

		qcom,mdss-dsi-off-command = [05 01 00 00 00 00 02 28 00
					05 01 00 00 78 00 02 10 00];
		qcom,mdss-dsi-on-command-state = "dsi_lp_mode";
		qcom,mdss-dsi-off-command-state = "dsi_hs_mode";
		qcom,mdss-dsi-h-sync-pulse = <1>;
		qcom,mdss-dsi-traffic-mode = "burst_mode";
		qcom,mdss-dsi-lane-map = "lane_map_0123";
		qcom,mdss-dsi-bllp-eof-power-mode;
		qcom,mdss-dsi-bllp-power-mode;
		qcom,mdss-dsi-lane-0-state;
		qcom,mdss-dsi-lane-1-state;
		qcom,mdss-dsi-lane-2-state;
		qcom,mdss-dsi-lane-3-state;
		qcom,mdss-dsi-panel-timings = [92 1A 12 00 3E 42 16 1E 14 03 04 00];
		qcom,mdss-dsi-t-clk-post = <0x04>;
		qcom,mdss-dsi-t-clk-pre = <0x1C>;
		qcom,mdss-dsi-bl-min-level = <11>;
		qcom,mdss-dsi-bl-max-level = <255>;
		qcom,mdss-dsi-bl-pmic-pwm-frequency = <100>;
		qcom,mdss-dsi-bl-pmic-bank-select = <0>;
		qcom,mdss-dsi-dma-trigger = "trigger_sw";
		qcom,mdss-dsi-mdp-trigger = "none";
		qcom,mdss-dsi-pwm-gpio = <&pm8909_mpps 2 0>;
		qcom,mdss-dsi-bl-pmic-control-type = "bl_ctrl_pwm";
		qcom,mdss-dsi-reset-sequence = <1 5>, <0 10>, <1 5>;
	};
};
