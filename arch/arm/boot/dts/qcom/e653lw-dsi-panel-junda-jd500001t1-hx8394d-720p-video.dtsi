/* Copyright (c) 2014, The Linux Foundation. All rights reserved.
 *
 * This program is free software; you can redistribute it and/or modify
 * it under the terms of the GNU General Public License version 2 and
 * only version 2 as published by the Free Software Foundation.
 *
 * This program is distributed in the hope that it will be useful,
 * but WITHOUT ANY WARRANTY; without even the implied warranty of
 * MERCHANTABILITY or FITNESS FOR A PARTICULAR PURPOSE.  See the
 * GNU General Public License for more details.
 */

&mdss_mdp {
	dsi_junda_jd500001t1_hx8394d_fwvga_video: qcom,mdss_dsi_junda_jd500001t1_hx8394d_fwvga_video {
		qcom,mdss-dsi-panel-name = "junda jd500001t1 hx8394d fwvga video mode dsi panel";
		qcom,mdss-dsi-panel-controller = <&mdss_dsi0>;
		qcom,mdss-dsi-panel-type = "dsi_video_mode";
		qcom,mdss-dsi-panel-destination = "display_1";
		qcom,mdss-dsi-panel-framerate = <60>;
		qcom,mdss-dsi-virtual-channel-id = <0>;
		qcom,mdss-dsi-stream = <0>;
		qcom,mdss-dsi-panel-width = <720>;
		qcom,mdss-dsi-panel-height = <1280>;
		qcom,mdss-dsi-h-front-porch = <52>;
		qcom,mdss-dsi-h-back-porch = <100>;
		qcom,mdss-dsi-h-pulse-width = <24>;
		qcom,mdss-dsi-h-sync-skew = <0>;
		qcom,mdss-dsi-v-front-porch = <8>;
		qcom,mdss-dsi-v-back-porch = <20>;
		qcom,mdss-dsi-v-pulse-width = <4>;
		qcom,mdss-dsi-h-left-border = <0>;
		qcom,mdss-dsi-h-right-border = <0>;
		qcom,mdss-dsi-v-top-border = <0>;
		qcom,mdss-dsi-v-bottom-border = <0>;
		qcom,mdss-dsi-bpp = <24>;
		qcom,mdss-dsi-color-order = "rgb_swap_rgb";
		qcom,mdss-dsi-underflow-color = <0xff>;
		qcom,mdss-dsi-border-color = <0>;
		qcom,mdss-dsi-on-command = [
                    //Set EXTC 
                    39 01 00 00 00 00 04
                    B9 FF 83 94

                    //BA-Set MIPI
                    39 01 00 00 00 00 03
                    BA 33 83

                    //B1-Set Power
                    39 01 00 00 00 00 10
                    B1 6E 12 12 37 04 11 F1 80 D9 94 23 80 C0 D2 18

                    //B2-Set DISP
                    39 01 00 00 00 00 0C
                    B2 00 64 0E 0D 32 23 08 08 1C 4D 00

                    //B4-Set GIP Timing
                    39 01 00 00 00 00 0D
                    B4 00 FF 03 50 03 50 03 50 01 6A 01 6A

                    //
                    39 01 00 00 00 00 02
                    BC 07

                    //
                    39 01 00 00 00 00 04
                    BF 41 0E 01

                    //D3
                    39 01 00 00 00 00 1F
                    D3 00 07 00 00 00 10 00 32 10 05 00 00 32 10 00 00 00 32 10 00 00 00 36 03 09 09 37 00 00 37

                    //D5, Forward scan
                    39 01 00 00 00 00 2D
                    D5 02 03 00 01 06 07 04 05 20 21 22 23 18 18 18 18 18 18 18 18 18 18 18 18 18 18 18 18 18 18 18 18 18 18 18 18 18 18 24 25 19 19 18 18

                    //D6, GIP Backword
                    39 01 00 00 00 00 2D
                    D6 05 04 07 06 01 00 03 02 23 22 21 20 18 18 18 18 18 18 58 58 18 18 18 18 18 18 18 18 18 18 18 18 18 18 18 18 18 18 25 24 18 18 19 19

                    //CC-Set Panel
                    39 01 00 00 00 00 02
                    CC 09

                    //
                    39 01 00 00 00 00 03
                    C0 30 14

                    //C7-Set TCONOPT
                    39 01 00 00 00 00 05
                    C7 00 C0 40 C0

                    //B6-Set VCOM
                    39 01 00 00 00 00 03
                    B6 66 66 

                    05 01 00 00 c8 00 02 11 00
                    05 01 00 00 0a 00 02 29 00];
		qcom,mdss-dsi-off-command = [05 01 00 00 00 00 02 28 00
				05 01 00 00 00 00 02 10 00];
		qcom,mdss-dsi-on-command-state = "dsi_lp_mode";
		qcom,mdss-dsi-off-command-state = "dsi_hs_mode";
		qcom,mdss-dsi-h-sync-pulse = <1>;
		qcom,mdss-dsi-traffic-mode = "burst_mode";
		qcom,mdss-dsi-lane-map = "lane_map_0123";
		qcom,mdss-dsi-bllp-eof-power-mode;
		qcom,mdss-dsi-bllp-power-mode;
		qcom,mdss-dsi-lane-0-state;
		qcom,mdss-dsi-lane-1-state;
		qcom,mdss-dsi-lane-2-state;
		qcom,mdss-dsi-lane-3-state;
		qcom,mdss-dsi-panel-timings = [79 1a 12 00 3e 42 16 1e 15 03 04 00];
		qcom,mdss-dsi-t-clk-post = <0x04>;
		qcom,mdss-dsi-t-clk-pre = <0x1b>;
		qcom,mdss-dsi-bl-min-level = <1>;
		qcom,mdss-dsi-bl-max-level = <255>;
		qcom,mdss-dsi-bl-pmic-control-type = "bl_ctrl_pwm";
		qcom,mdss-dsi-bl-pmic-pwm-frequency = <100>;
		qcom,mdss-dsi-bl-pmic-bank-select = <0>;
		qcom,mdss-dsi-pwm-gpio = <&pm8909_mpps 2 0>;
		qcom,mdss-dsi-dma-trigger = "trigger_sw";
		qcom,mdss-dsi-mdp-trigger = "none";
		qcom,mdss-dsi-reset-sequence = <1 20>, <0 1>, <1 20>;
	};
};


