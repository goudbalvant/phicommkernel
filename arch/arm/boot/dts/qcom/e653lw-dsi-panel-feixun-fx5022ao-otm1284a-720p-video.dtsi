/* Copyright (c) 2014, The Linux Foundation. All rights reserved.
 *
 * This program is free software; you can redistribute it and/or modify
 * it under the terms of the GNU General Public License version 2 and
 * only version 2 as published by the Free Software Foundation.
 *
 * This program is distributed in the hope that it will be useful,
 * but WITHOUT ANY WARRANTY; without even the implied warranty of
 * MERCHANTABILITY or FITNESS FOR A PARTICULAR PURPOSE.  See the
 * GNU General Public License for more details.
 */

&mdss_mdp {
	dsi_feixun_fx5022ao_otm1284a_720p_video: qcom,mdss_dsi_feixun_fx5022ao_otm1284a_720p_video {
		qcom,mdss-dsi-panel-name = "feixun fx5022ao otm1284a 720p video mode dsi panel";
		qcom,mdss-dsi-panel-controller = <&mdss_dsi0>;
		qcom,mdss-dsi-panel-type = "dsi_video_mode";
		qcom,mdss-dsi-panel-destination = "display_1";
		qcom,mdss-dsi-panel-framerate = <60>;
		qcom,mdss-dsi-virtual-channel-id = <0>;
		qcom,mdss-dsi-stream = <0>;
		qcom,mdss-dsi-panel-width = <720>;
		qcom,mdss-dsi-panel-height = <1280>;
		qcom,mdss-dsi-h-front-porch = <44>;
		qcom,mdss-dsi-h-back-porch = <42>;
		qcom,mdss-dsi-h-pulse-width = <2>;
		qcom,mdss-dsi-h-sync-skew = <0>;
		qcom,mdss-dsi-v-front-porch = <16>;
		qcom,mdss-dsi-v-back-porch = <14>;
		qcom,mdss-dsi-v-pulse-width = <2>;
		qcom,mdss-dsi-h-left-border = <0>;
		qcom,mdss-dsi-h-right-border = <0>;
		qcom,mdss-dsi-v-top-border = <0>;
		qcom,mdss-dsi-v-bottom-border = <0>;
		qcom,mdss-dsi-bpp = <24>;
		qcom,mdss-dsi-color-order = "rgb_swap_rgb";
		qcom,mdss-dsi-underflow-color = <0xff>;
		qcom,mdss-dsi-border-color = <0>;
		qcom,mdss-dsi-on-command = [
			29 01 00 00 00 00 02 00 00
			//EXTC=1
			29 01 00 00 00 00 04 FF 12 84 01
			//OrisE modE Enable
			29 01 00 00 00 00 02 00 80
			29 01 00 00 00 00 03 FF 12 84

			//-------------------- panel setting --------------------//
			//TCON Setting
			29 01 00 00 00 00 02 00 80
			29 01 00 00 00 00 0A C0 00 64 00 10 10 00 64 10 10
			//Panel Timing Setting
			29 01 00 00 00 00 02 00 90
			29 01 00 00 00 00 07 C0 00 5C 00 01 00 04


			29 01 00 00 00 00 02 00 A2
			29 01 00 00 00 00 04 C0 01 00 00
			//Interval Scan Frame: 0 Frame, Column inversion
			29 01 00 00 00 00 02 00 B3
			29 01 00 00 00 00 03 C0 00 55

			//framE rate:60Hz
			29 01 00 00 00 00 02 00 81
			29 01 00 00 00 00 02 C1 55

			//-------------------- power setting --------------------//
			//dcdC setting
			29 01 00 00 00 00 02 00 A0
			29 01 00 00 00 00 0F C4 05 10 04 02 05 15 11 05 10 07 02 05 15 11
			    
			//clamp voltagE setting
			29 01 00 00 00 00 02 00 B0
			29 01 00 00 00 00 03 C4 00 00
			    
			//VGH=13V, VGL=-12V, pump ratio:VGH=6x, VGL=-5x
			29 01 00 00 00 00 02 00 91
			29 01 00 00 00 00 03 C5 29 52

			//GVDD=4.204V, NGVDD=-4.204V (gammA 2.2) 
			29 01 00 00 00 00 02 00 00
			29 01 00 00 00 00 03 D8 84 84
			    
			    
			//VCOM=0.240 For gvdd=4.2 (gammA 2.2)
			29 01 00 00 00 00 02 00 00
			29 01 00 00 00 00 02 D9 31   //×î³õÎª0D ÑÏÖØ·º°×ÇÒFLICKER
			    
			//VDD_18V=1.7V, LVDSVDD=1.6V
			29 01 00 00 00 00 02 00 B3
			29 01 00 00 00 00 02 C5 84
			    
			//LVD voltagE level setting
			29 01 00 00 00 00 02 00 BB
			29 01 00 00 00 00 02 C5 8a
			    
			//chopper
			29 01 00 00 00 00 02 00 82
			29 01 00 00 00 00 02 C4 0A
			    
			//debounce
			29 01 00 00 00 00 02 00 C6
			29 01 00 00 00 00 02 B0 03
			    
			//prechargE Disable
			29 01 00 00 00 00 02 00 C2
			29 01 00 00 00 00 02 F5 40
			    
			//samplE holD gvdd
			29 01 00 00 00 00 02 00 C3
			29 01 00 00 00 00 02 F5 85

			//-------------------- Control setting --------------------//
			//ID1
			29 01 00 00 00 00 02 00 00
			29 01 00 00 00 00 02 D0 40
			    
			//ID2, ID3
			29 01 00 00 00 00 02 00 00
			29 01 00 00 00 00 03 D1 00 00

			//-------------------- power on setting --------------------//
			//sourcE Blanking FramE = Black, Defacult='30'
			29 01 00 00 00 00 02 00 80
			29 01 00 00 00 00 02 C4 00
			    
			//vcom Discharge=gnd:'10', '00'=disable
			29 01 00 00 00 00 02 00 98
			29 01 00 00 00 00 02 C5 10
			    
			29 01 00 00 00 00 02 00 81
			// ibias off
			29 01 00 00 00 00 02 F5 15
			29 01 00 00 00 00 02 00 83
			// lvD off
			29 01 00 00 00 00 02 F5 15
			29 01 00 00 00 00 02 00 85
			// gvdD off
			29 01 00 00 00 00 02 F5 15
			29 01 00 00 00 00 02 00 87
			// lvdsvdD off
			29 01 00 00 00 00 02 F5 15
			29 01 00 00 00 00 02 00 89
			// nvdd_18 off
			29 01 00 00 00 00 02 F5 15
			29 01 00 00 00 00 02 00 8B
			// En_vcom off
			29 01 00 00 00 00 02 F5 15
			    
			29 01 00 00 00 00 02 00 95
			// pump3 off
			29 01 00 00 00 00 02 F5 15
			29 01 00 00 00 00 02 00 97
			// pump4 off
			29 01 00 00 00 00 02 F5 15
			29 01 00 00 00 00 02 00 99
			// pump5 off
			29 01 00 00 00 00 02 F5 15

			29 01 00 00 00 00 02 00 A1
			// gammA off
			29 01 00 00 00 00 02 F5 15
			29 01 00 00 00 00 02 00 A3
			// sD ibias off
			29 01 00 00 00 00 02 F5 15
			29 01 00 00 00 00 02 00 A5
			// sdpch off
			29 01 00 00 00 00 02 F5 15
			29 01 00 00 00 00 02 00 A7
			// sdpch Bias off
			29 01 00 00 00 00 02 F5 15
			29 01 00 00 00 00 02 00 Ab
			// DdC osC off
			29 01 00 00 00 00 02 F5 18
			    
			//VCL pump Dis
			29 01 00 00 00 00 02 00 94
			29 01 00 00 00 00 03 F5 00 00

			//VCL reg. En
			29 01 00 00 00 00 02 00 D2
			29 01 00 00 00 00 03 F5 06 15
			    
			//VGLO, VGHO setting
			29 01 00 00 00 00 02 00 B1
			29 01 00 00 00 00 0E F5 15 00 00 00 00 00 00 00 00 03 15 08 15

			//VGLO1/2 Pull low setting
			29 01 00 00 00 00 02 00 B4
			//d[7] vglo1 D[6] vglo2 => 0: pull vss, 1: pull vgl
			29 01 00 00 00 00 02 C5 CC

			//-------------------- For Power IC ---------------------------------
			//Mode-3
			29 01 00 00 00 00 02 00 90
			29 01 00 00 00 00 05 F5 02 11 02 15

			//2xVPNL, 1.5*=00, 2*=50, 3*=a0
			29 01 00 00 00 00 02 00 90
			29 01 00 00 00 00 02 C5 50
			    
			//Frequency
			29 01 00 00 00 00 02 00 94
			29 01 00 00 00 00 02 C5 66

			//-------------------- panel timing statE Control --------------------//
			//panel timing statE Control
			29 01 00 00 00 00 02 00 80
			29 01 00 00 00 00 0C CB 00 00 00 00 00 00 00 00 00 00 00

			//panel timing statE Control
			29 01 00 00 00 00 02 00 90
			29 01 00 00 00 00 10 CB 00 00 00 00 00 00 00 00 00 00 00 FF 00 FF 00

			//panel timing statE Control
			29 01 00 00 00 00 02 00 A0
			29 01 00 00 00 00 10 CB FF 00 FF 00 00 00 00 00 00 00 00 00 00 00 00

			//panel timing statE Control
			29 01 00 00 00 00 02 00 B0
			29 01 00 00 00 00 10 CB 00 00 00 FF 00 FF 00 FF 00 FF 00 00 00 00 00

			//panel timing statE Control
			29 01 00 00 00 00 02 00 C0
			29 01 00 00 00 00 10 CB 00 00 00 00 00 00 00 05 05 00 05 05 05 05 05

			//panel timing statE Control
			29 01 00 00 00 00 02 00 D0
			29 01 00 00 00 00 10 CB 05 05 05 05 05 00 00 00 00 00 00 00 00 00 05

			//panel timing statE Control
			29 01 00 00 00 00 02 00 E0
			29 01 00 00 00 00 0F CB 05 00 05 05 05 05 05 05 05 05 05 05 00 00

			//panel timing statE Control
			29 01 00 00 00 00 02 00 F0
			29 01 00 00 00 00 0C CB FF FF FF FF FF FF FF FF FF FF FF

			//-------------------- panel paD mapping Control --------------------//
			//panel paD mapping Control
			29 01 00 00 00 00 02 00 80
			29 01 00 00 00 00 10 CC 00 00 00 00 00 00 00 05 07 00 11 15 13 17 0D

			//panel paD mapping Control
			29 01 00 00 00 00 02 00 90
			29 01 00 00 00 00 10 CC 09 0F 0B 01 03 00 00 00 00 00 00 00 00 00 06

			//panel paD mapping Control
			29 01 00 00 00 00 02 00 A0
			29 01 00 00 00 00 0F CC 08 00 12 16 14 18 0E 0A 10 0C 02 04 00 00

			//panel paD mapping Control
			29 01 00 00 00 00 02 00 B0
			29 01 00 00 00 00 10 CC 00 00 00 00 00 00 00 04 02 00 14 18 12 16 0C

			//panel paD mapping Control
			29 01 00 00 00 00 02 00 C0
			29 01 00 00 00 00 10 CC 10 0A 0E 08 06 00 00 00 00 00 00 00 00 00 03

			//panel paD mapping Control
			29 01 00 00 00 00 02 00 D0
			29 01 00 00 00 00 0F CC 01 00 13 17 11 15 0B 0F 09 0D 07 05 00 00

			//-------------------- panel timing setting --------------------//
			//panel VST setting
			29 01 00 00 00 00 02 00 80
			29 01 00 00 00 00 0D CE 87 03 28 86 03 28 85 03 28 84 03 28

			//panel VEND setting
			29 01 00 00 00 00 02 00 90
			29 01 00 00 00 00 0F CE 34 FC 28 34 FD 28 34 FE 28 34 FF 28 00 00

			//panel CLKA1/2 setting
			29 01 00 00 00 00 02 00 A0
			29 01 00 00 00 00 0F CE 38 07 05 00 00 28 00 38 06 05 01 00 28 00

			//panel CLKA3/4 setting
			29 01 00 00 00 00 02 00 B0
			29 01 00 00 00 00 0F CE 38 05 05 02 00 28 00 38 04 05 03 00 28 00

			//panel CLKb1/2 setting
			29 01 00 00 00 00 02 00 C0
			29 01 00 00 00 00 0F CE 38 03 05 04 00 28 00 38 02 05 05 00 28 00

			//panel CLKb3/4 setting
			29 01 00 00 00 00 02 00 D0
			29 01 00 00 00 00 0F CE 38 01 05 06 00 28 00 38 00 05 07 00 28 00

			//panel CLKc1/2 setting
			29 01 00 00 00 00 02 00 80
			29 01 00 00 00 00 0F CF 38 07 05 00 00 18 25 38 06 05 01 00 18 25

			//panel CLKc3/4 setting
			29 01 00 00 00 00 02 00 90
			29 01 00 00 00 00 0F CF 38 05 05 02 00 18 25 38 04 05 03 00 18 25

			//panel CLKd1/2 setting
			29 01 00 00 00 00 02 00 A0
			29 01 00 00 00 00 0F CF 38 03 05 04 00 18 25 38 02 05 05 00 18 25

			//panel CLKd3/4 setting
			29 01 00 00 00 00 02 00 B0
			29 01 00 00 00 00 0F CF 38 01 05 06 00 18 25 38 00 05 07 00 18 25

			//panel ECLK setting
			29 01 00 00 00 00 02 00 C0
			29 01 00 00 00 00 0C CF 01 01 20 20 00 00 01 81 00 03 08

			//-------------------- gammA --------------------//
			29 01 00 00 00 00 02 00 00
			29 01 00 00 00 00 15 E1 04 10 1B 28 35 44 46 73 63 7F 84 6E 7C 56 53 45 3A 2B 18 10

			29 01 00 00 00 00 02 00 00
			29 01 00 00 00 00 15 E2 04 10 1B 28 35 44 46 73 63 7F 84 6E 7C 56 53 45 3A 2B 18 10


			//OrisE modE Disable
			29 01 00 00 00 00 02 00 00
			29 01 00 00 00 00 04 FF FF FF FF

			05 01 00 00 C8 00 02 11 00
			05 01 00 00 64 00 02 29 00];

		qcom,mdss-dsi-off-command = [05 01 00 00 00 00 02 28 00
					05 01 00 00 78 00 02 10 00];
		qcom,mdss-dsi-on-command-state = "dsi_lp_mode";
		qcom,mdss-dsi-off-command-state = "dsi_hs_mode";
		qcom,mdss-dsi-h-sync-pulse = <1>;
		qcom,mdss-dsi-traffic-mode = "burst_mode";
		qcom,mdss-dsi-lane-map = "lane_map_0123";
		qcom,mdss-dsi-bllp-eof-power-mode;
		qcom,mdss-dsi-bllp-power-mode;
		qcom,mdss-dsi-lane-0-state;
		qcom,mdss-dsi-lane-1-state;
		qcom,mdss-dsi-lane-2-state;
		qcom,mdss-dsi-lane-3-state;
		qcom,mdss-dsi-panel-timings = [92 1A 12 00 3E 42 16 1E 14 03 04 00];
		qcom,mdss-dsi-t-clk-post = <0x04>;
		qcom,mdss-dsi-t-clk-pre = <0x1C>;
		qcom,mdss-dsi-bl-min-level = <11>;
		qcom,mdss-dsi-bl-max-level = <255>;
		qcom,mdss-dsi-bl-pmic-pwm-frequency = <100>;
		qcom,mdss-dsi-bl-pmic-bank-select = <0>;
		qcom,mdss-dsi-dma-trigger = "trigger_sw";
		qcom,mdss-dsi-mdp-trigger = "none";
		qcom,mdss-dsi-pwm-gpio = <&pm8909_mpps 2 0>;
		qcom,mdss-dsi-bl-pmic-control-type = "bl_ctrl_pwm";
		qcom,mdss-dsi-reset-sequence = <1 5>, <0 30>, <1 30>;
	};
};
